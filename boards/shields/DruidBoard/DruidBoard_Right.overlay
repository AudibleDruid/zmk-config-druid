#include DruidBoard.dtsi

/ {
    default_kscan: kscan {
        compatible = "zmk,kscan-gpio-matrix";
        label = "default_kscan";
        diode-direction = "col2row";
        col-offset = <6>;

        row-gpios = <&pro_micro 15 (GPIO_ACTIVE_HIGH | GPIO_PULL_DOWN)>,
                    <&pro_micro 14 (GPIO_ACTIVE_HIGH | GPIO_PULL_DOWN)>,
                    <&pro_micro 16 (GPIO_ACTIVE_HIGH | GPIO_PULL_DOWN)>,
                    <&pro_micro 10 (GPIO_ACTIVE_HIGH | GPIO_PULL_DOWN)>,
                    <&pro_micro 6 (GPIO_ACTIVE_HIGH | GPIO_PULL_DOWN)>;

        col-gpios = <&pro_micro 1 GPIO_ACTIVE_HIGH>,
                    <&pro_micro 0 GPIO_ACTIVE_HIGH>,
                    <&pro_micro 21 GPIO_ACTIVE_HIGH>,
                    <&pro_micro 20 GPIO_ACTIVE_HIGH>,
                    <&pro_micro 19 GPIO_ACTIVE_HIGH>,
                    <&pro_micro 18 GPIO_ACTIVE_HIGH>;
    };
};