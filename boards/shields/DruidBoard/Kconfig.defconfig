## boards/shields/DruidBoard/Kconfig.defconfig
```kconfig
if SHIELD_DRUIDBOARD_LEFT

config ZMK_KEYBOARD_NAME
    default "DruidBoard"

config ZMK_SPLIT_ROLE_CENTRAL
    default y

endif

if SHIELD_DRUIDBOARD_LEFT || SHIELD_DRUIDBOARD_RIGHT

config ZMK_SPLIT
    default y

endif
```

## boards/shields/DruidBoard/Kconfig.shield
```kconfig
config SHIELD_DRUIDBOARD_LEFT
    def_bool $(shields_list_contains,DruidBoard_Left)

config SHIELD_DRUIDBOARD_RIGHT
    def_bool $(shields_list_contains,DruidBoard_Right)
```

## config/boards/shields/DruidBoard_Left/Kconfig.defconfig
```kconfig
if SHIELD_DRUIDBOARD_LEFT

config ZMK_KEYBOARD_NAME
    default "DruidBoard"

endif
```

## config/boards/shields/DruidBoard_Left/Kconfig.shield
```kconfig
config SHIELD_DRUIDBOARD_LEFT
    def_bool $(shields_list_contains, DruidBoard_Left)
```
